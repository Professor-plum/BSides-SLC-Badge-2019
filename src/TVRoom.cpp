#include "TVRoom.h"
#include "FlashReader.h"

const int ecx = TVx + 48;
const int ecy = TVy - 10;
const int poses[5][2] = {{48, 13}, {43, 25}, {35, 35}, {25, 43}, {13, 48}}; 


const uint8_t qrcode[] PROGMEM = { 
0xfe, 0x2e, 0x55, 0x12, 0x4b, 0xfc, 0x16, 0x83, 0x6d, 0x46, 0x90, 0x6e, 0x9a, 0x10, 0x32, 
0x74, 0xbb, 0x75, 0xfb, 0x7f, 0x2, 0x35, 0xdb, 0xa7, 0x71, 0xfd, 0x63, 0xae, 0xc1, 0x60, 
0x44, 0x7a, 0x1, 0x7, 0xfa, 0xaa, 0xaa, 0xaa, 0xaf, 0xe0, 0x2, 0x2d, 0x13, 0x53, 0x0, 
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0x4f, 0xb, 0x5, 0x93, 0x10, 0xb1, 0xaa, 0xcf, 0xea, 0x1b, 0x59, 0x71, 0x51, 0x0, 
 };

void TVRoom::refresh(Adafruit_ILI9341_STM *tft, unsigned long now){
  FR.blt("tv.raw", tft, 0, 0, 240, 320);
  out = false;
  redraw = true;
}

roomID TVRoom::update(Adafruit_ILI9341_STM *tft, unsigned long now){
  if ((ears[0] == 1) && (ears[1] == 2)) {//10:07
      wheel_set(C_TV, true);
      tft->fillRect(TVx, TVy, 8, 48, ILI9341_WHITE);
      tft->fillRect(TVx+56, TVy, 8, 48, ILI9341_WHITE);
      tft->fillRect(TVx+8, TVy, 48, 2, ILI9341_WHITE);
      tft->fillRect(TVx+8, TVy+46, 48, 2, ILI9341_WHITE);
      tft->drawBitmap(TVx+8, TVy+1, qrcode, 48, 45, ILI9341_BLACK, ILI9341_WHITE);
    }
    else {
      uint8_t noise[384];
      for (int i=0; i< sizeof(noise); ++i)
        noise[i] = random(256);
      tft->drawBitmap(TVx, TVy, noise, 64, 48, ILI9341_BLACK, ILI9341_WHITE);
    }
  if (redraw) {
    //tft->fillRect(ecx-48, ecy-48, 96, 48, tft->color565(165, 187, 116));
    FR.blt("tvback.raw", tft, ecx-48, ecy-48, 96, 48);
    tft->drawLine(ecx, ecy, ecx - poses[ears[0]][0], ecy - poses[ears[0]][1], ILI9341_DARKGREY);
    tft->drawLine(ecx, ecy, ecx + poses[ears[1]][0], ecy - poses[ears[1]][1], ILI9341_DARKGREY);
    redraw= false;
  }
  if (sho) {
    FR.blt("tvhint.raw", tft, 47, 35, 92, 60);
    sho =false;
  }

  if ((now % 1000) < 500)
    FR.blt("tvt.raw", tft, 13, 215, 14, 4);
  else
    tft->fillRect(13, 215, 14, 4, tft->color565(33, 33, 33));
  if (out) return R_MARKET;
  return R_NOCHANGE;
}
  
void TVRoom::touchDown(int x, int y) {
  if ((x > 208) && (y > 65))
    out = true;
  if ((x>48) && (y>36) && (x<140) && (y<96))
    sho = true;
  touchMove(x,y);
}
 
void TVRoom::touchMove(int x, int y) {
  if ((x>=TVx) && (x< (TVx + 96)) && (y > (ecy - 60)) && (y < ecy)) {
    redraw = true;
    int slope = 10*(x-ecx)/(y-ecy);
    if (slope < -20) ears[1]=0;
    else if (slope < -13) ears[1]=1;
    else if (slope < -8) ears[1]=2;
    else if (slope < -4) ears[1]=3;
    else if (slope < -1) ears[1]=4;
    else if (slope > 20) ears[0]=0;
    else if (slope > 13) ears[0]=1;
    else if (slope > 8) ears[0]=2;
    else if (slope > 4) ears[0]=3;
    else if (slope > 1) ears[0]=4;
  }
}


